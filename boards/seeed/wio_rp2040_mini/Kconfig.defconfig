## boards/seeed/wio_rp2040_mini/Kconfig.defconfig
```kconfig
# Copyright (c) 2026 Saleemuddin Shaik
# SPDX-License-Identifier: Apache-2.0

if BOARD_WIO_RP2040_MINI

if I2C_DW

config I2C_DW_CLOCK_SPEED
	default 125

endif # I2C_DW

config USB_SELF_POWERED
	default n

endif # BOARD_WIO_RP2040_MINI
```

## boards/seeed/wio_rp2040_mini/Kconfig.wio_rp2040_mini
```kconfig
# Copyright (c) 2026 Saleemuddin Shaik
# SPDX-License-Identifier: Apache-2.0

config BOARD_WIO_RP2040_MINI
	select SOC_RP2040
	select RP2_FLASH_W25Q080
```
